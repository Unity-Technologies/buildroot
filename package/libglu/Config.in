## package/libglu/Config.in
```kconfig
comment "libglu needs an OpenGL backend"
	depends on !BR2_PACKAGE_HAS_LIBGL

config BR2_PACKAGE_LIBGLU
	bool "libglu"
	depends on BR2_PACKAGE_HAS_LIBGL
	help
	  Mesa OpenGL Utility library

	  http://cgit.freedesktop.org/mesa/glu/

if BR2_PACKAGE_LIBGLU

config UNITY3D_PACKAGE_LIBGLU_STATIC_PIC
	bool "(Unity3D) Compile static library with PIC"
	help
      Always compile a libGLU.a, and force PIC.

endif
```
